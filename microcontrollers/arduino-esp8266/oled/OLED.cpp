#include <Wire.h>
#include "OLED.h"

//==========================================================//

// Small 8x8 font
static const char myFont[][8] PROGMEM = {
{0x00,0x00,0x00,0x00,0x00,0x00,0x00,0x00},
{0x00,0x00,0x5F,0x00,0x00,0x00,0x00,0x00},
{0x00,0x00,0x07,0x00,0x07,0x00,0x00,0x00},
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{0x00,0x02,0x05,0x05,0x02,0x00,0x00,0x00}
};


//==========================================================//
// Resets display depending on the actual mode.
void OLED::reset_display(void)
{
  displayOff();
  clear_display();
  displayOn();
}

//==========================================================//
// Turns display on.
void OLED::displayOn(void)
{
  sendcommand(0xaf);        //display on
}

//==========================================================//
// Turns display off.
void OLED::displayOff(void)
{
  sendcommand(0xae);		//display off
}

//==========================================================//
// Clears the display by sendind 0 to all the screen map.
void OLED::clear_display(void)
{
  unsigned char i, k;
  for(k=0; k<4 /*8*/; k++)
  {
    setXY(k, 0);
    {
      for(i=0; i<(128 + 2 * _offset); i++)     //locate all COL
      {
        SendChar(0);         //clear all COL
        //delay(10);
      }
    }
  }
}

//==========================================================//
// Actually this sends a byte, not a char to draw in the display.
// Display's chars uses 8 byte font the small ones and 96 bytes
// for the big number font.
void OLED::SendChar(unsigned char data)
{
//#define xt_rsil(level) (__extension__({uint32_t state; __asm__ __volatile__("rsil %0," __STRINGIFY(level) : "=a" (state)); state;}))
//#define xt_wsr_ps(state)  __asm__ __volatile__("wsr %0,ps; isync" :: "a" (state) : "memory")

    // Disable all interrupts and return the interrupts enabled before disabling them.
//    int x = xt_rsil(0);

    Wire.beginTransmission(_address); // begin transmitting
    Wire.write(0x40);//data mode
    Wire.write(data);
    Wire.endTransmission();    // stop transmitting

    // Enable interrupts specified by intSave
//    xt_wsr_ps(x);
}

//==========================================================//
// Prints a display char (not just a byte) in coordinates X Y,
// being multiples of 8. This means we have 16 COLS (0-15)
// and 8 ROWS (0-7).
void OLED::sendCharXY(unsigned char data, int X, int Y)
{
    // Disable all interrupts and return the interrupts enabled before disabling them.
//    int x = xt_rsil(0);

  setXY(X, Y);
  Wire.beginTransmission(_address); // begin transmitting
  Wire.write(0x40);//data mode

  for(int i=0;i<8;i++)
    Wire.write(pgm_read_byte(myFont[data-0x20]+i));

  Wire.endTransmission();    // stop transmitting

    // Enable interrupts specified by intSave
//    xt_wsr_ps(x);
}

//==========================================================//
// Used to send commands to the display.
void OLED::sendcommand(unsigned char com)
{
  Wire.beginTransmission(_address);     //begin transmitting
  Wire.write(0x80);                          //command mode
  Wire.write(com);
  Wire.endTransmission();                    // stop transmitting
}

//==========================================================//
// Set the cursor position in a 16 COL * 8 ROW map.
void OLED::setXY(unsigned char row,unsigned char col)
{
  sendcommand(0xb0+row);                //set page address
  sendcommand(_offset+(8*col&0x0f));       //set low col address
  sendcommand(0x10+((8*col>>4)&0x0f));  //set high col address
}


//==========================================================//
// Prints a string regardless the cursor position.
void OLED::sendStr(unsigned char *string)
{
  unsigned char i=0;
  while(*string)
  {
    for(i=0;i<8;i++)
    {
      SendChar(pgm_read_byte(myFont[*string-0x20]+i));
    }
    *string++;
  }
}

//==========================================================//
// Prints a string in coordinates X Y, being multiples of 8.
// This means we have 16 COLS (0-15) and 8 ROWS (0-7).
void OLED::sendStrXY( const char *string, int X, int Y)
{
  setXY(X,Y);
  unsigned char i=0;
  while(*string)
  {
    for(i=0;i<8;i++)
    {
      SendChar(pgm_read_byte(myFont[*string-0x20]+i));
    }
    *string++;
  }
}


//==========================================================//
// Inits oled and draws logo at startup
void OLED::init_OLED(void)
{
  sendcommand(0xae);		//display off
  sendcommand(0xa6);            //Set Normal Display (default)
    // Adafruit Init sequence for 128x64 OLED module
    sendcommand(0xAE);             //DISPLAYOFF
    sendcommand(0xD5);            //SETDISPLAYCLOCKDIV
    sendcommand(0x80);            // the suggested ratio 0x80
    sendcommand(0xA8);            //SSD1306_SETMULTIPLEX
#if 1 /* 128x32 */
    sendcommand(32 - 1);
#else /* 128x64 */
    sendcommand(64 - 1);
#endif
    sendcommand(0xD3);            //SETDISPLAYOFFSET
    sendcommand(0x0);             //no offset
    sendcommand(0x40 | 0x0);      //SETSTARTLINE
    sendcommand(0x8D);            //CHARGEPUMP
    sendcommand(0x14);
    sendcommand(0x20);             //MEMORYMODE
    sendcommand(0x00);             //0x0 act like ks0108

    //sendcommand(0xA0 | 0x1);      //SEGREMAP   //Rotate screen 180 deg
    sendcommand(0xA0);

    //sendcommand(0xC8);            //COMSCANDEC  Rotate screen 180 Deg
    sendcommand(0xC0);

#if 1 /* 128x32 */
    sendcommand(0xDA);          // SETCOMPINS
    sendcommand(0x02);
    sendcommand(0x81);          // SETCONTRAST
    sendcommand(0x8F);
#else /* 128x64 */
    sendcommand(0xDA);            //0xDA
    sendcommand(0x12);           //COMSCANDEC
    sendcommand(0x81);           //SETCONTRAS
    sendcommand(0xCF);           //
#endif
    sendcommand(0xd9);          //SETPRECHARGE
    sendcommand(0xF1);
    sendcommand(0xDB);        //SETVCOMDETECT
    sendcommand(0x40);
    sendcommand(0xA4);        //DISPLAYALLON_RESUME
    sendcommand(0xA6);        //NORMALDISPLAY

  clear_display();
  sendcommand(0x2e);            // stop scroll
  //----------------------------REVERSE comments----------------------------//
    sendcommand(0xa0);		//seg re-map 0->127(default)
    sendcommand(0xa1);		//seg re-map 127->0
    sendcommand(0xc8);
    delay(1000);
  //----------------------------REVERSE comments----------------------------//
  // sendcommand(0xa7);  //Set Inverse Display
  // sendcommand(0xae);		//display off
  sendcommand(0x20);            //Set Memory Addressing Mode
  sendcommand(0x00);            //Set Memory Addressing Mode ab Horizontal addressing mode
  //  sendcommand(0x02);         // Set Memory Addressing Mode ab Page addressing mode(RESET)
}


//==========================================================//


OLED::OLED(uint8_t sda, uint8_t scl, uint8_t address, uint8_t offset) {
	_sda = sda;
	_scl = scl;
	_address = address;
	_offset = offset;
}

void OLED::begin(void) {
	// set up i2c
	Wire.begin(_sda, _scl);
	init_OLED();
	reset_display();
}

void OLED::on(void) {
	DEBUG_PRINTLN("on");
	displayOn();
}

void OLED::off(void) {
	DEBUG_PRINTLN("off");
	displayOff();
}

void OLED::clear(void) {
	DEBUG_PRINTLN("clear");
	clear_display();
}

void OLED::print(char *s, uint8_t r, uint8_t c) {
	DEBUG_PRINT("print ");
	DEBUG_PRINT(r);
	DEBUG_PRINT(",");
	DEBUG_PRINT(c);
	DEBUG_PRINT(" ");
	DEBUG_PRINTLN(s);
	sendStrXY(s, r, c);
}
