## microcontrollers/esp-idf/console/defconfig
```kconfig
CONFIG_ESP32_XTAL_FREQ_26=y
CONFIG_FREERTOS_USE_TRACE_FACILITY=y
CONFIG_FREERTOS_USE_STATS_FORMATTING_FUNCTIONS=y
CONFIG_FREERTOS_VTASKLIST_INCLUDE_COREID=y
CONFIG_FREERTOS_GENERATE_RUN_TIME_STATS=y
CONFIG_FREERTOS_RUN_TIME_STATS_USING_ESP_TIMER=y
```

## microcontrollers/esp-idf/tdisplay/defconfig
```kconfig
CONFIG_ESP32_XTAL_FREQ_40=y
CONFIG_ESPTOOLPY_FLASHSIZE_4MB=y
CONFIG_WIDTH=135
CONFIG_OFFSETX=52
CONFIG_OFFSETY=40
CONFIG_MOSI_GPIO=19
CONFIG_CS_GPIO=5
CONFIG_DC_GPIO=16
CONFIG_RESET_GPIO=23
CONFIG_BL_GPIO=4
CONFIG_ESP32_DEFAULT_CPU_FREQ_240=y
```
