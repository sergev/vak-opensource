#
# Тест пошагового прохождения исключений для отладчика GDB.
# Плата MC-24R_EM, генератор 10 МГц.
#
		.set	noreorder
		.set	mips32

#---------------------------------------
# Регистры управления периферией Elvees Multicore.
#
#include "io-mc24.h"

#---------------------------------------
# Начало по адресу 0xBFC00000
#
		.org	0
		la	$v0, CA_IV		# используется спец.вектор 0x200
		mtc0	$v0, C0_CAUSE

		la	$v0, ST_BEV | ST_CU0 | ST_CU1
		mtc0	$v0, C0_STATUS		# векторы в ПЗУ, разрешение FPU

		li	$v0, 2			# запрещаем кэширование сегмента kseg0
		mtc0	$v0, C0_CONFIG

		li	$v0, 0			# обнуляем FCSR
		ctc1    $v0, C1_FCSR

		la	$v1, MC_CSR		# регистр CSR, умножаем частоту на 6
		la	$v0, 0x00010061
		sw	$v0, ($v1)

		la	$v1, MC_CSCON0		# регистр CSCON0
		la	$v0, MC_CSCON_E | \
				MC_CSCON_WS (0) | \
				MC_CSCON_T | \
				MC_CSCON_W64 | \
				MC_CSCON_CSBA (0x00000000) | \
				MC_CSCON_CSMASK (0xF8000000)
		sw	$v0, ($v1)

		la	$v1, MC_CSCON1		# регистр CSCON1
		la	$v0, 0
		sw	$v0, ($v1)

		la	$v1, MC_CSCON2		# регистр CSCON2
		la	$v0, 0
		sw	$v0, ($v1)

		la	$v1, MC_CSCON3		# регистр CSCON3, 5 wait states
		la	$v0, MC_CSCON_WS (3)
		sw	$v0, ($v1)

		la	$v1, MC_CSCON4		# регистр CSCON4
		la	$v0, 0
		sw	$v0, ($v1)

		la	$v1, MC_SDRCON		# регистр SDRCON
		la	$v0, MC_SDRCON_INIT | \
				MC_SDRCON_BL_PAGE | \
				MC_SDRCON_RFR (64000000/8192, 60000) | \
				MC_SDRCON_PS_512
		sw	$v0, ($v1)

		li	$2, 0			# обнуляем регистры
		li	$3, 0
		li	$4, 0
		li	$5, 0
		li	$6, 0
		li	$7, 0
		li	$8, 0
		li	$9, 0
		li	$10, 0
		li	$11, 0
		li	$12, 0
		li	$13, 0
		li	$14, 0
		li	$15, 0
		li	$16, 0
		li	$17, 0
		li	$18, 0
		li	$19, 0
		li	$20, 0
		li	$21, 0
		li	$22, 0
		li	$23, 0
		li	$24, 0
		li	$25, 0
		li	$26, 0
		li	$27, 0
		li	$28, 0
		li	$29, 0
		li	$30, 0
		li	$31, 0

		la	$ra, start		# Чтобы gdb не ругался

		j	start			# Переходим к тесту
		nop				# (слот задержки)

#---------------------------------------
# Исключение TLB по адресу 0xBFC00200
#
		.org	0x0200
tlb_refill:	j 	.			# не используется
		nop				# (слот задержки)

#---------------------------------------
# Вход в исключение по адресу 0xBFC00380
#
		.org	0x0380
exception:
		mfc0	$k0, C0_EPC
		mfc0	$k1, C0_CAUSE
		addi	$k0, $k0, 4		# возвращаемся на следующую команду
		slti	$k1, $k1, 0		# k1=1 если установлен бит BD
		addi	$s8, $k0, 4		# пропускаем слот задержки
		movn	$k0, $s8, $k1		# если установлен бит BD
		mtc0	$k0, C0_EPC
		nop
		nop
		nop
		eret				# выход из исключения
		nop				# (слот задержки)

#---------------------------------------
# Вход в прерывание по адресу 0xBFC00400
#
		.org	0x0400
interrupt:	j 	.			# не используется
		nop				# (слот задержки)

#---------------------------------------
# Начало теста по адресу 0xBFC00500
#
		.org	0x0500
start:
		break	0, 1			# останавливаемся в отладчике
		nop

#
# Тест 1: невыровненный адрес программы.
#
		li	$v0, 1
		jr	$v0
		nop				# (слот задержки)
		nop

#
# Тест 2: неверный код инструкции.
#
		.word	0x60000000
		nop

#
# Тест 3: переполнение.
#
		lui	$v0, 0x7777
		add	$v1, $v0, $v0
		nop

#
# Тест 4: невыровненный адрес данных.
#
		li	$v0, 1
		lw	$v1, ($v0)
		nop

#
# Тест 5: неверный код инструкции в слоте перехода.
#
		j	.+8
		.word	0x60000000
		nop

#
# Тест 6: переполнение в слоте перехода.
#
		lui	$v0, 0x7777
		j	.+8
		add	$v1, $v0, $v0
		nop

#
# Тест 7: невыровненный адрес данных в слоте перехода.
#
		li	$v0, 1
		j	.+8
		lw	$v1, ($v0)
		nop
end:
		j	start
		nop
